/*
 * StopWatch V16.3: clean-text-only revision to first five effects.
 * Byte-for-byte original V16.1 rendering remains available for 6-31.
 * Glyphs generated by the actual V16 browser Canvas, then quantized to
 * 4-bit antialiased masks with RLE compression. Nothing is rasterized by
 * M5GFX fonts at runtime. Custom names are composed from the same masks.
 * ESP32-S3 PSRAM storage ~310 KB, FLASH compressed masks ~136 KB.
 */
#pragma once
#include "Browser5Assets.h"
#include <esp_heap_caps.h>

struct B5View { const uint8_t *p; int w,h; };
static uint8_t *b5GlyphPixels=nullptr,*b5WordPixels=nullptr,*b5DynamicWord=nullptr;
static bool b5Attempted=false,b5Ready=false;
static String b5DynamicName="";
static B5View b5Named={nullptr,0,0};

static int b5Code(char c){
 if(c>='A'&&c<='Z')return c-'A';
 if(c>='a'&&c<='z')return 26+c-'a';
 if(c>='0'&&c<='9')return 52+c-'0';
 if(c=='+')return 62;if(c=='/')return 63;return -1;
}
static inline uint8_t b5Nib(const uint8_t *p,int ix){
 const uint8_t v=p[(unsigned)ix>>1];return (ix&1)?(v&15):(v>>4);
}
static inline void b5SetNib(uint8_t *p,int ix,uint8_t v){
 uint8_t &b=p[(unsigned)ix>>1];if(ix&1)b=(b&0xF0)|(v&15);else b=(b&0x0F)|(v<<4);
}
// Small self-contained base64 and RLE decoders; no large runtime graphics libraries.
static size_t b5Base64Decode(const char *src,uint8_t *dst,size_t capacity){
 uint32_t bits=0;int count=0;size_t at=0;
 for(size_t i=0;;i++){
  int c=(unsigned char)pgm_read_byte(src+i);
  if(!c)break;
  int v=-1;
  if(c>='A'&&c<='Z')v=c-'A';else if(c>='a'&&c<='z')v=c-'a'+26;
  else if(c>='0'&&c<='9')v=c-'0'+52;else if(c=='+')v=62;else if(c=='/')v=63;
  if(v<0)continue;
  bits=(bits<<6)|(uint32_t)v;count+=6;
  if(count>=8){count-=8;if(at>=capacity)return 0;dst[at++]=(uint8_t)(bits>>count);}
 }
 return at;
}
static bool b5UnRLE(const uint8_t *p,size_t sz,uint8_t *out,size_t want){
 size_t i=0,j=0;
 while(i<sz){uint8_t code=p[i++];if(code>=128){size_t len=code-128;if(i>=sz||j+len>want)return false;
    memset(out+j,p[i++],len);j+=len;
   }else{size_t len=code;if(len==0||i+len>sz||j+len>want)return false;
    memcpy(out+j,p+i,len);i+=len;j+=len;}}
 return j==want;
}
static bool b5Load(const char *b64,uint8_t *dst,size_t dstBytes){
 size_t sourceLength=strlen_P(b64);size_t maxBytes=(sourceLength*3)/4+4;
 uint8_t *compressed=(uint8_t*)heap_caps_malloc(maxBytes,MALLOC_CAP_SPIRAM|MALLOC_CAP_8BIT);
 if(!compressed)return false;
 size_t count=b5Base64Decode(b64,compressed,maxBytes);
 bool ok=count&&b5UnRLE(compressed,count,dst,dstBytes);
 heap_caps_free(compressed);return ok;
}
static bool b5Initialize(){
 if(b5Attempted)return b5Ready;b5Attempted=true;
 b5WordPixels=(uint8_t*)heap_caps_malloc(B5_WORD_BYTES,MALLOC_CAP_SPIRAM|MALLOC_CAP_8BIT);
 b5GlyphPixels=(uint8_t*)heap_caps_malloc(B5_GLYPHS_BYTES,MALLOC_CAP_SPIRAM|MALLOC_CAP_8BIT);
 b5DynamicWord=(uint8_t*)heap_caps_malloc(466*108/2,MALLOC_CAP_SPIRAM|MALLOC_CAP_8BIT);
 if(b5GlyphPixels&&b5WordPixels&&b5DynamicWord){
   b5Ready=b5Load(B5_WORD_RLE64,b5WordPixels,B5_WORD_BYTES)&&
           b5Load(B5_GLYPHS_RLE64,b5GlyphPixels,B5_GLYPHS_BYTES);
 }
 Serial.printf("V16.2 browser glyph assets: %s, free PSRAM %u\n",b5Ready?"OK":"FAILED",(unsigned)ESP.getFreePsram());
 return b5Ready;
}
static bool b5GlyphFor(char ch,Browser5Glyph &out){
 for(int i=0;i<B5_GLYPH_COUNT;i++){
  memcpy_P(&out,&B5_GLYPHS[i],sizeof(Browser5Glyph));
  if(out.c==(uint8_t)ch)return true;
 }
 return false;
}
// Construct a custom-name word mask only when that name actually changes.
// The default "zaven" path below always uses exact whole-word browser pixels.
static B5View b5Word(const String &name){
 if(name=="zaven")return {b5WordPixels,(int)B5_WORD_W,(int)B5_WORD_H};
 if(name==b5DynamicName && b5Named.p)return b5Named;
 b5DynamicName=name;
 memset(b5DynamicWord,0,466*108/2);
 int total=0;
 const int L=clampi(name.length(),0,12);
 for(int i=0;i<L;i++){Browser5Glyph g;if(b5GlyphFor(name[i],g))total+=g.advance;else total+=40;}
 float scale=fminf(1.f,400.f/fmaxf(1,total)*78.f/61.f);
 int canvasW=clampi((int)(total*.782f*scale)+52,96,466);
 float pen=26.f;
 for(int k=0;k<L;k++){
  Browser5Glyph g;if(!b5GlyphFor(name[k],g)){pen+=30*scale;continue;}
  float glyphCx=pen+g.advance*.782f*scale*.5f;
  for(int yy=0;yy<g.h;yy++)for(int xx=0;xx<g.w;xx++){
   int gx=(int)(glyphCx+(xx+(int)g.x-53)*.782f*scale);
   int gy=(int)(54+(yy+(int)g.y-63)*.782f*scale);
   if((unsigned)gx>=(unsigned)canvasW||(unsigned)gy>=108)continue;
   uint8_t v=b5Nib(b5GlyphPixels,(int)g.start*2+yy*g.w+xx);
   const int target=gy*canvasW+gx;
   if(v>b5Nib(b5DynamicWord,target))b5SetNib(b5DynamicWord,target,v);
  }
  pen+=g.advance*.782f*scale;
 }
 b5Named={b5DynamicWord,canvasW,108};return b5Named;
}
static inline uint16_t b5Hue(float hue0){return hue(hue0);}
static inline uint16_t b5Mix(uint16_t bg,uint16_t src,uint8_t alpha){
 const int ia=255-alpha;
 const int r=(((bg>>11)&31)*ia+((src>>11)&31)*alpha+127)/255;
 const int g=(((bg>>5)&63)*ia+((src>>5)&63)*alpha+127)/255;
 const int b=((bg&31)*ia+(src&31)*alpha+127)/255;
 return (uint16_t)((r<<11)|(g<<5)|b);
}
// Font Laboratory: same animation geometry, three independent text engines.
#include "FontTrial.h"
static void b5Stamp(B5View v,float x,float y,float width,float radians,uint16_t c,float fade=1.f){
  (void)v;trialWord(artName(effectID),x,y,width,radians,c,fade);
}
static void b5Char(char ch,float x,float y,float scale,uint16_t c,float radians=0){
  trialChar(ch,x,y,scale,c,radians);
}
static float b5Rhythm(){return beatClock*TAU;}
static float b5HousePulse(){return expf(-beatPhase()*10.f);}
static inline uint16_t b5Lit(float h,float intensity){return tint(b5Hue(frac(h)),intensity);}
static bool renderBrowserFive(uint8_t id){
 if(id<23||id>27)return false;
 if(!b5Initialize())return false; // safe V16.1 fallback if PSRAM allocation fails
 const String &word=artName(effectID);
 const int n=clampi(word.length(),1,12);
 const float t=T(), hb=b5Rhythm(), pulse=b5HousePulse();
 B5View wordMask=b5Word(word);
 black();
 switch(id){
 case 23:{ // 01 Chromatic EQ: browser letter size/positions, five individual colors.
  const uint16_t cols[5]={rgb(86,250,255),rgb(252,93,189),rgb(247,235,105),rgb(136,247,105),rgb(186,130,255)};
  float gap=fminf(79.f,410.f/n),font=fminf(78.f,fmaxf(31.f,430.f/fmaxf(5,n)*.9f));
  for(int i=0;i<n;i++){
   int bi=(int)((i+.5f)*32/n);
   float m=clampf((band(bi)+band(bi+1)+band(bi+2))*.33f);
   float osc=.5f+.5f*sinf(hb*.5f+i*1.38f);
   float x=CX+(i-(n-1)*.5f)*gap;
   float y=214-((m*.8f+osc*.20f)*112.f-50.f);
   // V17: cached 3x3 coverage smoothing on native letters ONLY here.
#if STOPWATCH_FONT_TRIAL==2
   trialCharSoft(word[i],x,y,1.70f*(font/78.f)*(n<=6?2.65f:fmaxf(1.15f,12.f/n)),cols[i%5],0.f);
#else
   b5Char(word[i],x,y,1.70f*(font/78.f)*(n<=6?2.65f:fmaxf(1.15f,12.f/n)),cols[i%5]);
#endif
   line(x,318,x,302-m*59,cols[i%5],2);
  }
  break;}
 case 24:{ // 02 Psychedelic Halo: 12 smooth wavy contours + dancing letters.
  const float p=hb*.12f;
  for(int k=12;k>0;k--){
   float r=23+k*16+bass*19;
   float lastX=0,lastY=0;
   for(int j=0;j<=180;j++){
    float a=TAU*j/180.f;
    float rr=r*(1+.13f*sinf(a*7+p+k*.4f)+.070f*sinf(a*13-p*2));
    float x=CX+cosf(a)*rr,y=CY+sinf(a)*rr;
    if(j)line(lastX,lastY,x,y,b5Lit((k*31+t*4)/360.f,.56f),2);
    lastX=x;lastY=y;
   }
  }
  // Use effect 01's clean native glyph scale AND letter tracking.
  float gap=fminf(79.f,410.f/n);
  float font=fminf(78.f,fmaxf(31.f,430.f/fmaxf(5,n)*.9f));
  for(int i=0;i<n;i++){
   float x=CX+(i-(n-1)*.5f)*gap;
   float y=CY+21*sinf(t*1.15f+i*.81f)+7*sinf(t*.56f+i*1.48f)+8*bass*sinf(hb+i*.4f);
   b5Char(word[i],x,y,1.70f*(font/78.f)*(n<=6?2.65f:fmaxf(1.15f,12.f/n)),
          (i%2)?rgb(255,189,255):rgb(255,242,254),.075f*sinf(p+i*.6f+t*.15f));
  }
  break;}
 case 25:{ // 03 Kaleidoscope: close-fit circle recalculated for every new word
  float p=hb*.07f;
  const float requestWidth=1.50f*fminf(210.f,wordMask.w*.65f);
  // D text is native FreeSansBold at discrete size buckets, rather than
  // the browser mask. Measure that same font instead of using browser widths.
  float bucket=clampf(roundf(requestWidth/6.f)*6.f,24.f,450.f);
  float zoom=bucket>=270.f?clampf(bucket/200.f,1.f,1.95f):1.f;
  if(bucket<90.f)cv.setFont(&lgfx::fonts::FreeSansBold12pt7b);
  else if(bucket<175.f)cv.setFont(&lgfx::fonts::FreeSansBold18pt7b);
  else cv.setFont(&lgfx::fonts::FreeSansBold24pt7b);
  cv.setTextSize(1.f);
  const float letterW=fminf(452.f,cv.textWidth(word)*zoom);
  const float letterH=cv.fontHeight()*zoom;
  cv.setFont(&lgfx::fonts::Font0);
  int ringR=clampi((int)ceilf(hypotf(letterW*.5f,letterH*.5f)+10.f),49,187);
  // V16.12: keep a VISIBLE gap after the ring. Calculate each outer word's
  // native D bounding circle at its 18pt text tier, rather than positioning
  // the glyph center only 25px beyond the ring (which caused collisions).
  cv.setFont(&lgfx::fonts::FreeSansBold18pt7b);
  cv.setTextSize(1.f);
  float outerRadius=hypotf(cv.textWidth(word)*.5f,cv.fontHeight()*.5f);
  cv.setFont(&lgfx::fonts::Font0);
  const float clearGap=15.f;
  int firstWedge=clampi((int)ceilf(ringR+outerRadius+clearGap),94,280);
  for(int slice=0;slice<8;slice++){
   float base=slice*TAU/8.f+p;
   for(int rr=firstWedge;rr<230;rr+=46){
    float angle=base+(slice&1?PI_F:0);
    float x=CX+sinf(base)*rr,y=CY-cosf(base)*rr;
    float width=fminf(110.f,rr*.61f);
    b5Stamp(wordMask,x,y,width,angle,b5Hue(frac((slice*36+rr*.25f+t*5)/360.f)),.91f);
   }
  }
  circ(CX,CY,ringR,rgb(230,225,255),2);
  b5Stamp(wordMask,CX,CY,requestWidth,0,rgb(232,211,255),1.f);
  break;}
 case 26:{ // 04 Round Resonator: six complete words circulate the rings.
  float p=hb*.065f;
  for(int k=0;k<15;k++){
   float r=28+k*14+band((k*2)%32)*22;
   circ(CX,CY,(int)r,b5Lit((180+k*17+t*5)/360.f,.50f+energy*.18f),1);
  }
  for(int i=0;i<6;i++){
   float phi=i*TAU/6.f+p;
   float rr=117+22*sinf(hb*.5f+i)+13*bass*sinf(hb+i*.9f);
   float x=CX+cosf(phi)*rr,y=CY+sinf(phi)*rr;
   b5Stamp(wordMask,x,y,fminf(110.f,n*21.f),phi+PI_F*.5f,b5Hue(frac(i/8.f)),.87f);
  }
  break;}
 case 27:{ // 05 Fibonacci Spiral: V6 whole-word composition, NOT glyph dashes.
  const float golden=2.39996322972865f;
  float motion=t*.092f+beatClock*.002f;
  float breath=1+.28f*bass+.12f*energy;
  for(int i=0;i<120;i++){
   float f=frac(i/120.f+motion*.38f),r=(14+217*sqrtf(f))*breath+band(i%32)*18.f,a=i*golden+motion*.21f;
   int x=CX+(int)(cosf(a)*r),y=CY+(int)(sinf(a)*r);
   if((unsigned)x<(unsigned)W&&(unsigned)y<(unsigned)H)
      cv.drawPixel(x,y,b5Lit(frac(i*.071f+t*.012f),.28f+.45f*(1-f)));
  }
  for(int i=0;i<26;i++){
   float f=frac(i/26.f+motion),r=(28+203*sqrtf(f))*breath+band(i%32)*21.f,a=i*golden+motion*.35f;
   float fade=clampf(f*8)*clampf((1-f)*6)*(.49f+.36f*pulse+.45f*energy+.16f*bass);
   float width=fminf(106.f,fmaxf(74.f,n*16.f))*(.66f+f*.28f);
   b5Stamp(wordMask,CX+cosf(a)*r,CY+sinf(a)*r,width,a+PI_F*.5f,b5Hue(frac(i/8.f)),fade);
  }
  circ(CX,CY,(int)(25+13*bass),b5Lit((222+t*8)/360.f,.32f+.25f*energy),2);
  break;}
 }
 return true;
}